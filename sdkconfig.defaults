## sdkconfig.defaults
```kconfig
CONFIG_IDF_TARGET="esp32s3"
CONFIG_ESP_CONSOLE_UART_BAUDRATE=115200
CONFIG_FATFS_LFN_HEAP=y
CONFIG_SPI_MASTER_IN_IRAM=y
CONFIG_ESPTOOLPY_FLASHSIZE_8MB=y
CONFIG_ESPTOOLPY_FLASHSIZE="8MB"
CONFIG_PARTITION_TABLE_CUSTOM=y
CONFIG_PARTITION_TABLE_CUSTOM_FILENAME="partitions.csv"
CONFIG_PARTITION_TABLE_FILENAME="partitions.csv"
CONFIG_PARTITION_TABLE_OFFSET=0x8000
CONFIG_TINYUSB_ENABLED=y
CONFIG_TINYUSB_DEVICE_ENABLED=y
CONFIG_TINYUSB_MSC_ENABLED=y
CONFIG_TINYUSB_MSC_BUFSIZE=16384
CONFIG_TINYUSB_DEBUG_LEVEL=0
CONFIG_TINYUSB_DESC_USE_DEFAULT_CONFIG=y
# LOG timestamp
CONFIG_LOG_TIMESTAMP_SOURCE_SYSTEM=y
# CONFIG_LOG_TIMESTAMP_SOURCE_RTOS is not set
```
